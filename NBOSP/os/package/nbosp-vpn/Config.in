## NBOSP/os/package/nbosp-vpn/Config.in
```kconfig
config BR2_PACKAGE_NBOSP_VPN
	bool "NBOSP restricted VPN helper"
	depends on BR2_x86_64
	select BR2_PACKAGE_BASH
	select BR2_PACKAGE_WIREGUARD_TOOLS
	help
	  Install the restricted helper that manages a persistent WireGuard
	  tunnel for the NovaByte app network broker.
```

## NBOSP/os/package/noto-bengali/Config.in
```kconfig
config BR2_PACKAGE_NOTO_BENGALI
	bool "Noto Sans Bengali font (Regular + Bold)"
	depends on BR2_PACKAGE_FONTCONFIG
	help
	  Install Google's Noto Sans Bengali Regular and Bold for Bengali
	  (bn) in NW.js and other Fontconfig-aware applications.
```
