## NBOSP/os/Config.in
```kconfig
menu "NBOSP"

source "$BR2_EXTERNAL_NBOSP_PATH/package/labwc/Config.in"
source "$BR2_EXTERNAL_NBOSP_PATH/package/nbosp-kiosk/Config.in"
source "$BR2_EXTERNAL_NBOSP_PATH/package/nbosp-power/Config.in"
source "$BR2_EXTERNAL_NBOSP_PATH/package/nbosp-install/Config.in"
source "$BR2_EXTERNAL_NBOSP_PATH/package/noto-emoji/Config.in"
source "$BR2_EXTERNAL_NBOSP_PATH/package/noto-sans/Config.in"
source "$BR2_EXTERNAL_NBOSP_PATH/package/noto-cjk/Config.in"
source "$BR2_EXTERNAL_NBOSP_PATH/package/noto-arabic/Config.in"
source "$BR2_EXTERNAL_NBOSP_PATH/package/noto-devanagari/Config.in"

endmenu
```

## NBOSP/os/configs/nbosp_x86_64_defconfig
```kconfig
BR2_x86_64=y
BR2_TOOLCHAIN_BUILDROOT=y
BR2_TOOLCHAIN_BUILDROOT_GLIBC=y
BR2_TOOLCHAIN_BUILDROOT_CXX=y
BR2_ENABLE_LOCALE=y
BR2_SHARED_LIBS=y
BR2_KERNEL_HEADERS_AS_KERNEL=y
BR2_PACKAGE_HOST_LINUX_HEADERS_CUSTOM_6_12=y
BR2_TARGET_GENERIC_HOSTNAME="nbosp"
BR2_TARGET_GENERIC_ISSUE="NBOSP live boot"
BR2_TARGET_GENERIC_GETTY=y
BR2_TARGET_GENERIC_GETTY_PORT="tty2"
BR2_SYSTEM_DHCP="eth0"
BR2_ROOTFS_DEVICE_CREATION_DYNAMIC_EUDEV=y
BR2_PACKAGE_EUDEV=y
BR2_ROOTFS_USERS_TABLES="$(BR2_EXTERNAL_NBOSP_PATH)/board/nbosp/users.table"
BR2_SYSTEM_BIN_SH_BUSYBOX=y
BR2_PACKAGE_BUSYBOX_CONFIG_FRAGMENT_FILES="$(BR2_EXTERNAL_NBOSP_PATH)/board/nbosp/busybox.fragment"
BR2_PACKAGE_LIBGTK3=y
BR2_PACKAGE_LIBGTK3_WAYLAND=y
BR2_PACKAGE_LIBNSS=y
BR2_PACKAGE_LIBNSPR=y
BR2_PACKAGE_FONTCONFIG=y
BR2_PACKAGE_DEJAVU=y
BR2_PACKAGE_DEJAVU_SANS=y
BR2_PACKAGE_DEJAVU_MONO=y
BR2_PACKAGE_ALSA_LIB=y
BR2_PACKAGE_CUPS=y
BR2_PACKAGE_XORG7=y
BR2_PACKAGE_XLIB_LIBX11=y
BR2_PACKAGE_XLIB_LIBXCOMPOSITE=y
BR2_PACKAGE_XLIB_LIBXCURSOR=y
BR2_PACKAGE_XLIB_LIBXDAMAGE=y
BR2_PACKAGE_XLIB_LIBXEXT=y
BR2_PACKAGE_XLIB_LIBXFIXES=y
BR2_PACKAGE_XLIB_LIBXI=y
BR2_PACKAGE_XLIB_LIBXRANDR=y
BR2_PACKAGE_XLIB_LIBXRENDER=y
BR2_PACKAGE_XLIB_LIBXSCRNSAVER=y
BR2_PACKAGE_XLIB_LIBXTST=y
BR2_PACKAGE_MESA3D=y
BR2_PACKAGE_MESA3D_GALLIUM_DRIVER_SVGA=y
BR2_PACKAGE_MESA3D_OPENGL_EGL=y
BR2_PACKAGE_MESA3D_OPENGL_ES=y
BR2_PACKAGE_CAGE=y
BR2_PACKAGE_WLROOTS_XWAYLAND=y
BR2_PACKAGE_XWAYLAND=y
BR2_PACKAGE_SEATD=y
BR2_PACKAGE_SEATD_DAEMON=y
BR2_PACKAGE_DBUS=y
BR2_PACKAGE_XKEYBOARD_CONFIG=y
BR2_PACKAGE_XDATA_XCURSOR_THEMES=y
BR2_PACKAGE_LIBARCHIVE=y
BR2_PACKAGE_LIBARCHIVE_BSDTAR=y
BR2_PACKAGE_UTIL_LINUX_LIBUUID=y
BR2_PACKAGE_OPENVMTOOLS=y
BR2_PACKAGE_OPENVMTOOLS_RESOLUTIONKMS=y
BR2_PACKAGE_NBOSP_KIOSK=y
BR2_PACKAGE_NBOSP_POWER=y
BR2_PACKAGE_NBOSP_INSTALL=y
BR2_LINUX_KERNEL=y
BR2_LINUX_KERNEL_CUSTOM_VERSION=y
BR2_LINUX_KERNEL_CUSTOM_VERSION_VALUE="6.12.18"
BR2_LINUX_KERNEL_USE_DEFCONFIG=y
BR2_LINUX_KERNEL_DEFCONFIG="x86_64"
BR2_LINUX_KERNEL_CONFIG_FRAGMENT_FILES="$(BR2_EXTERNAL_NBOSP_PATH)/board/nbosp/linux.fragment"
BR2_TARGET_ROOTFS_CPIO=y
BR2_TARGET_ROOTFS_CPIO_GZIP=y
BR2_TARGET_ROOTFS_TAR=y
```

## NBOSP/os/package/nbosp-app-supervisor/Config.in
```kconfig
config BR2_PACKAGE_NBOSP_APP_SUPERVISOR
	bool "NBOSP per-app UID supervisor"
	depends on BR2_x86_64
	select BR2_PACKAGE_LIBSELINUX
	select BR2_PACKAGE_POLICYCOREUTILS
	select BR2_PACKAGE_REFPOLICY
	help
	  Install a root-only helper and a peer-credential-checked Unix socket
	  service for installing, launching, terminating, and removing verified
	  apps under stable per-app UIDs. App processes receive seccomp and rlimit
	  restrictions and are placed in resource-limited cgroup v2 groups. The
	  package also supplies the early SELinux policy-loading init wrapper.
```

## NBOSP/os/package/nbosp-kiosk/Config.in
```kconfig
config BR2_PACKAGE_NBOSP_KIOSK
	bool "NBOSP NW.js kiosk app"
	depends on BR2_x86_64
	depends on BR2_PACKAGE_NODEJS
	help
	  Install the Linux NW.js application bundle into the target filesystem.
```

## NBOSP/os/package/nbosp-selinux-init/Config.in
```kconfig
config BR2_PACKAGE_NBOSP_SELINUX_INIT
	bool "NBOSP SELinux init wrapper"
	depends on BR2_x86_64
	select BR2_PACKAGE_LIBSELINUX
	select BR2_PACKAGE_POLICYCOREUTILS
	select BR2_PACKAGE_REFPOLICY
	help
	  Load and label the permissive SELinux policy before handing off to
	  BusyBox init from the early initramfs entrypoint.
```

## NBOSP/os/package/noto-arabic/Config.in
```kconfig
config BR2_PACKAGE_NOTO_ARABIC
	bool "Noto Sans Arabic font (Regular + Bold)"
	depends on BR2_PACKAGE_FONTCONFIG
	help
	  Install Google's Noto Sans Arabic Regular and Bold for Arabic (ar)
	  in NW.js and other Fontconfig-aware applications.
```

## NBOSP/os/package/noto-cjk/Config.in
```kconfig
config BR2_PACKAGE_NOTO_CJK
	bool "Noto Sans CJK fonts (SC/JP/KR, Regular only)"
	depends on BR2_PACKAGE_FONTCONFIG
	help
	  Install per-region Noto Sans CJK subset fonts (Simplified Chinese,
	  Japanese and Korean) for zh-CN, ja and ko. Regular faces only:
	  the full-weight CJK set would add ~30MB of initramfs/ISO size for
	  bold headers Chromium already renders cleanly with synthetic bold.
```

## NBOSP/os/package/noto-devanagari/Config.in
```kconfig
config BR2_PACKAGE_NOTO_DEVANAGARI
	bool "Noto Sans Devanagari font (Regular + Bold)"
	depends on BR2_PACKAGE_FONTCONFIG
	help
	  Install Google's Noto Sans Devanagari Regular and Bold for Hindi
	  (hi) in NW.js and other Fontconfig-aware applications.
```

## NBOSP/os/package/noto-sans/Config.in
```kconfig
config BR2_PACKAGE_NOTO_SANS
	bool "Noto Sans font (Latin/Greek/Cyrillic)"
	depends on BR2_PACKAGE_FONTCONFIG
	help
	  Install Google's Noto Sans Regular and Bold for Latin, Greek and
	  Cyrillic scripts (en, es, fr, de, pt, ru, it) in NW.js and other
	  Fontconfig-aware applications.
```
